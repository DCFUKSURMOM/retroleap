## package/retroleap-packages/retroarch/Config.in
```kconfig
config BR2_PACKAGE_RETROARCH
        bool "Retroarch"
        select BR2_PACKAGE_LIBRETRO_CORE_INFO
        help
          A multi emulator frontend.

	  http://www.libretro.com
```
